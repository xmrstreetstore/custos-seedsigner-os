## opt/pi02w-dev/Config.in
```kconfig
source "../external-packages/python-urtypes/Config.in"
source "../external-packages/python-pyzbar/Config.in"
source "../external-packages/python-mock/Config.in"
source "../external-packages/python-embit/Config.in"
source "../external-packages/python-picamera/Config.in"
source "../external-packages/python-pillow-ep/Config.in"
source "../external-packages/libraqm/Config.in"
source "../external-packages/gh/Config.in"
source "../external-packages/python-pysatochip/Config.in"
source "../external-packages/python-pyscard/Config.in"
source "../external-packages/python-pygp/Config.in"
source "../external-packages/ccid-sec1210/Config.in"
```
